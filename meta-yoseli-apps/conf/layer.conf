## meta-yoseli-apps/conf/layer.conf
```bitbake
# Layer configuration for meta-yoseli-apps
BBPATH .= ":${LAYERDIR}"

BBFILES += "${LAYERDIR}/recipes-*/*/*.bb \
            ${LAYERDIR}/recipes-*/*/*.bbappend"

BBFILE_COLLECTIONS += "meta-yoseli-apps"
BBFILE_PATTERN_meta-yoseli-apps = "^${LAYERDIR}/"
BBFILE_PRIORITY_meta-yoseli-apps = "6"

LAYERDEPENDS_meta-yoseli-apps = "core"
LAYERSERIES_COMPAT_meta-yoseli-apps = "scarthgap whinlatter"
```

## meta-yoseli-distro/conf/distro/yoseli.conf
```bitbake
# Yoseli Distribution Configuration

DISTRO = "yoseli"
DISTRO_NAME = "Yoseli"
DISTRO_VERSION = "1.0"
DISTRO_CODENAME = "whinlatter"

# Maintainer
MAINTAINER = "Yoseli <contact@yoseli.org>"

# SDK naming
SDK_VENDOR = "-yoselisdk"
SDK_VERSION = "${DISTRO_VERSION}"
SDK_NAME = "${DISTRO}-${TCLIBC}-${SDKMACHINE}-${IMAGE_BASENAME}-${TUNE_PKGARCH}-${MACHINE}"

# Use systemd
DISTRO_FEATURES = "acl argp ext2 ipv4 ipv6 largefile usbhost wifi xattr zeroconf systemd"
DISTRO_FEATURES_BACKFILL_CONSIDERED = "sysvinit"
INIT_MANAGER = "systemd"

# Use IPK packages (fastest)
PACKAGE_CLASSES = "package_ipk"

# No X11/Wayland for headless systems
DISTRO_FEATURES:remove = "x11 wayland"

# Build optimization
INHERIT += "rm_work"

# Version information
DISTRO_EXTRA_RDEPENDS += "os-release"
```

## meta-yoseli-distro/conf/layer.conf
```bitbake
# Layer configuration for meta-yoseli-distro

BBPATH .= ":${LAYERDIR}"

BBFILES += "${LAYERDIR}/recipes-*/*/*.bb \
            ${LAYERDIR}/recipes-*/*/*.bbappend"

BBFILE_COLLECTIONS += "yoseli-distro"
BBFILE_PATTERN_yoseli-distro = "^${LAYERDIR}/"
BBFILE_PRIORITY_yoseli-distro = "8"

LAYERDEPENDS_yoseli-distro = "core"
LAYERSERIES_COMPAT_yoseli-distro = "whinlatter"
```
